## gpu-dual-vm/sw/meta-mali-gpu-xen/conf/layer.conf
```bitbake
# Layer configuration for meta-mali-gpu-xen
# Customizations for Mali G78AE GPU virtualization under Xen

BBPATH .= ":${LAYERDIR}"

BBFILES += " \
    ${LAYERDIR}/recipes-*/*/*.bb \
    ${LAYERDIR}/recipes-*/*/*.bbappend \
"

BBFILE_COLLECTIONS += "mali-gpu-xen"
BBFILE_PATTERN_mali-gpu-xen = "^${LAYERDIR}/"
BBFILE_PRIORITY_mali-gpu-xen = "10"

LAYERDEPENDS_mali-gpu-xen = "core xilinx-gpu-malig78ae"
LAYERSERIES_COMPAT_mali-gpu-xen = "scarthgap"
```
